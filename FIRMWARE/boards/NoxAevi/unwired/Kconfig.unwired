## FIRMWARE/boards/NoxAevi/unwired/board.yml
```yaml
board:
  name: unwired
  full_name: unwired
  vendor: NoxAevi
  socs:
    - name: nrf52840
```

## FIRMWARE/boards/NoxAevi/unwired/unwired_defconfig
```kconfig
#Enable MPU
CONFIG_ARM_MPU=y

#HW protection
CONFIG_HW_STACK_PROTECTION=y

#Enable Segger RTT
CONFIG_USE_SEGGER_RTT=y
CONFIG_SHELL=y
CONFIG_SHELL_BACKENDS=y
CONFIG_SHELL_BACKEND_RTT=y


#GPIO
CONFIG_GPIO=y
CONFIG_TIMEAWARE_GPIO=y

#LED
CONFIG_LED=y

#i2c
CONFIG_I2C=y
#CONFIG_I2C_SHELL=y

#spi
CONFIG_SPI=y
#CONFIG_SPI_SHELL=y

#MAX3421E
CONFIG_UHC_DRIVER=y
CONFIG_UHC_MAX3421E=y

#BLUETOOTH
CONFIG_BT=y

#pin control
CONFIG_PINCTRL=y
```
